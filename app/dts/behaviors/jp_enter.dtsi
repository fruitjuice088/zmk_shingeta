/*
 * Copyright (c) 2020 The ZMK Contributors
 *
 * SPDX-License-Identifier: MIT
 */

/ {
    behaviors {
#if ZMK_BEHAVIOR_OMIT(LT)
        /omit-if-no-ref/
#endif
        je: jp_enter {
            compatible = "zmk,behavior-jp-enter";
            #binding-cells = <1>;
            display-name = "JpEnter";
        };
    };
};
