/*
 * Copyright (c) 2020 The ZMK Contributors
 *
 * SPDX-License-Identifier: MIT
 */

/ {
    behaviors {
#if ZMK_BEHAVIOR_OMIT(LT)
        /omit-if-no-ref/
#endif
        sg: shingeta {
            compatible = "zmk,behavior-shingeta";
            #binding-cells = <1>;
            display-name = "Shingeta";
        };
    };
};
