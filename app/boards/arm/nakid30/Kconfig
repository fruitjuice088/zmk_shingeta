## app/boards/arm/nakid30/Kconfig
```kconfig
# Copyright (c) 2026 The ZMK Contributors
# SPDX-License-Identifier: MIT

# MDBT50Q-1MV2 内蔵インダクタ(Reg1)で DCDC を有効化できる。
# 高電圧モード(VDDH に電池直結)は取らず LDO で 3.3V を作る構成なので、
# HV DCDC(SOC_DCDC_NRF52X_HV)は有効にしない。
config BOARD_ENABLE_DCDC
    bool "Enable DCDC mode"
    select SOC_DCDC_NRF52X
    default y
    depends on (BOARD_NAKID30_LEFT || BOARD_NAKID30_RIGHT)
```

## app/boards/arm/nakid30/Kconfig.board
```kconfig
# nakid30 board configuration
#
# Copyright (c) 2026 The ZMK Contributors
# SPDX-License-Identifier: MIT

config BOARD_NAKID30_LEFT
    bool "nakid30 left"
    depends on SOC_NRF52840_QIAA

config BOARD_NAKID30_RIGHT
    bool "nakid30 right"
    depends on SOC_NRF52840_QIAA
```

## app/boards/arm/nakid30/Kconfig.defconfig
```kconfig
# Copyright (c) 2026 The ZMK Contributors
# SPDX-License-Identifier: MIT

if BOARD_NAKID30_LEFT || BOARD_NAKID30_RIGHT

config BOARD
    default "nakid30"

config ZMK_KEYBOARD_NAME
    default "nakid30"

config ZMK_SPLIT
    default y

# 外部電源スイッチ回路を持たない。
# nice_nano 系の EXT_POWER は P0.13 を制御に使うが、本設計では P0.13 = KEY2。
config ZMK_EXT_POWER
    default n

if ZMK_BLE

config ZMK_SLEEP
    default y

endif # ZMK_BLE

if USB_DEVICE_STACK

config USB_NRFX
    default y

endif # USB_DEVICE_STACK

config BT_CTLR
    default BT

endif # BOARD_NAKID30_LEFT || BOARD_NAKID30_RIGHT

if BOARD_NAKID30_RIGHT

# central は右手
config ZMK_SPLIT_ROLE_CENTRAL
    default y

endif # BOARD_NAKID30_RIGHT
```

## app/boards/nakid30_left.conf
```kconfig
CONFIG_ZMK_POINTING=y
CONFIG_ZMK_COMBO_MAX_COMBOS_PER_KEY=16

CONFIG_ZMK_BATTERY_REPORTING=y
CONFIG_ZMK_BATTERY_REPORT_INTERVAL=300

CONFIG_ZMK_SPLIT_BLE_PREF_INT=16

CONFIG_BT_CTLR_TX_PWR_0=y

CONFIG_ZMK_IDLE_SLEEP_TIMEOUT=600000
```

## app/boards/nakid30_right.conf
```kconfig
CONFIG_ZMK_POINTING=y
CONFIG_ZMK_COMBO_MAX_COMBOS_PER_KEY=16

CONFIG_ZMK_BATTERY_REPORTING=y
CONFIG_ZMK_BATTERY_REPORT_INTERVAL=300

CONFIG_ZMK_SPLIT_BLE_PREF_INT=16

CONFIG_BT_PERIPHERAL_PREF_MIN_INT=12
CONFIG_BT_PERIPHERAL_PREF_MAX_INT=24
CONFIG_ZMK_BLE_EXPERIMENTAL_CONN=y
CONFIG_BT_CTLR_TX_PWR_0=y

CONFIG_ZMK_IDLE_SLEEP_TIMEOUT=600000

CONFIG_BT_BAS=y
CONFIG_ZMK_SPLIT_BLE_CENTRAL_BATTERY_LEVEL_FETCHING=y
CONFIG_ZMK_SPLIT_BLE_CENTRAL_BATTERY_LEVEL_PROXY=y
```

## app/boards/shields/k30_ble_split/Kconfig.defconfig
```kconfig
# Copyright (c) 2026 The ZMK Contributors
# SPDX-License-Identifier: MIT

if SHIELD_K30_BLE_SPLIT_LEFT

config ZMK_KEYBOARD_NAME
    default "k30_ble_split"

config ZMK_SPLIT_ROLE_CENTRAL
    default y

endif

if SHIELD_K30_BLE_SPLIT_LEFT || SHIELD_K30_BLE_SPLIT_RIGHT

config ZMK_SPLIT
    default y

if ZMK_BLE

config ZMK_SLEEP
    default y

config ZMK_IDLE_SLEEP_TIMEOUT
    default 600000

endif # ZMK_BLE

endif
```

## app/boards/shields/k30_ble_split/Kconfig.shield
```kconfig
# Copyright (c) 2026 The ZMK Contributors
# SPDX-License-Identifier: MIT

config SHIELD_K30_BLE_SPLIT_LEFT
    def_bool $(shields_list_contains,k30_ble_split_left)

config SHIELD_K30_BLE_SPLIT_RIGHT
    def_bool $(shields_list_contains,k30_ble_split_right)
```

## app/boards/shields/k30_split/Kconfig.shield
```kconfig
# Copyright (c) 2026 The ZMK Contributors
# SPDX-License-Identifier: MIT

config SHIELD_K30_SPLIT_LEFT
    def_bool $(shields_list_contains,k30_split_left)

config SHIELD_K30_SPLIT_RIGHT
    def_bool $(shields_list_contains,k30_split_right)
```

## app/dts/bindings/behaviors/zmk,behavior-persistent-macro.yaml
```yaml
# Copyright (c) 2026 The ZMK Contributors
# SPDX-License-Identifier: MIT

description: Persistent Macro Behavior

compatible: "zmk,behavior-persistent-macro"

include: two_param.yaml
```
