## app/boards/shields/gku30/Kconfig.defconfig
```kconfig
# Copyright (c) 2020 The ZMK Contributors
# SPDX-License-Identifier: MIT

if SHIELD_GKU30

config ZMK_KEYBOARD_NAME
    default "gku30"

config ZMK_USB
    default y

endif
```

## app/boards/shields/gku30/Kconfig.shield
```kconfig
# Copyright (c) 2020 The ZMK Contributors
# SPDX-License-Identifier: MIT

config SHIELD_GKU30
    def_bool $(shields_list_contains,gku30)
```

## app/boards/shields/gku34/Kconfig.defconfig
```kconfig
# Copyright (c) 2020 The ZMK Contributors
# SPDX-License-Identifier: MIT

if SHIELD_GKU34

config ZMK_KEYBOARD_NAME
    default "gku34"

config ZMK_USB
    default y

endif
```

## app/boards/shields/gku34/Kconfig.shield
```kconfig
# Copyright (c) 2020 The ZMK Contributors
# SPDX-License-Identifier: MIT

config SHIELD_GKU34
    def_bool $(shields_list_contains,gku34)
```

## app/boards/shields/revxlp30/Kconfig.defconfig
```kconfig
# Copyright (c) 2020 The ZMK Contributors
# SPDX-License-Identifier: MIT

if SHIELD_REVXLP30

config ZMK_KEYBOARD_NAME
    default "revxlp30"

config ZMK_USB
    default y

if ZMK_BLE

# Deep sleep config
config ZMK_SLEEP
    default y # Enable deep sleep support
config ZMK_IDLE_SLEEP_TIMEOUT
    default 600000

config BT_GATT_ENFORCE_SUBSCRIPTION
    default n

config ZMK_BLE_THREAD_PRIORITY
    default 1

endif # ZMK_BLE

endif
```

## app/boards/shields/revxlp30/Kconfig.shield
```kconfig
# Copyright (c) 2020 The ZMK Contributors
# SPDX-License-Identifier: MIT

config SHIELD_REVXLP30
    def_bool $(shields_list_contains,revxlp30)
    select SPI
```

## app/boards/shields/revxlp34/Kconfig.defconfig
```kconfig
# Copyright (c) 2020 The ZMK Contributors
# SPDX-License-Identifier: MIT

if SHIELD_REVXLP34

config ZMK_KEYBOARD_NAME
    default "revxlp34"

config ZMK_USB
    default y

endif
```

## app/boards/shields/revxlp34/Kconfig.shield
```kconfig
# Copyright (c) 2020 The ZMK Contributors
# SPDX-License-Identifier: MIT

config SHIELD_REVXLP34
    def_bool $(shields_list_contains,revxlp34)
    select SPI
```

## app/boards/shields/revxlp36/Kconfig.defconfig
```kconfig
# Copyright (c) 2020 The ZMK Contributors
# SPDX-License-Identifier: MIT

if SHIELD_REVXLP36

config ZMK_KEYBOARD_NAME
    default "revxlp36"

config ZMK_USB
    default y

endif
```

## app/boards/shields/revxlp36/Kconfig.shield
```kconfig
# Copyright (c) 2020 The ZMK Contributors
# SPDX-License-Identifier: MIT

config SHIELD_REVXLP36
    def_bool $(shields_list_contains,revxlp36)
    select SPI
```

## app/dts/bindings/behaviors/zmk,behavior-jp-enter.yaml
```yaml
# Copyright (c) 2022 The ZMK Contributors
# SPDX-License-Identifier: MIT

description: JP-Enter Behavior

compatible: "zmk,behavior-jp-enter"

include: one_param.yaml

properties:
  je-entry-layer:
    type: int
    required: true
```

## app/dts/bindings/behaviors/zmk,behavior-shingeta.yaml
```yaml
# Copyright (c) 2022 The ZMK Contributors
# SPDX-License-Identifier: MIT

description: Shingeta Behavior

compatible: "zmk,behavior-shingeta"

include: one_param.yaml

properties:
  sg-entry-layer:
    type: int
    required: true
```
